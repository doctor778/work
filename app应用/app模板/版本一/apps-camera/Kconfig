## app应用/app模板/版本一/apps-camera/Kconfig
```kconfig
menuconfig BR2_PACKAGE_APPS_CAMERA
	bool "camera"
	select BR2_PACKAGE_PREBUILTS_LIBGE
	select BR2_PACKAGE_LIBLVGL
	select BR2_PACKAGE_PREBUILTS_LIBLRBALANCE
	select BR2_PACKAGE_PREBUILTS_LIBTWOTONE
	select BR2_PACKAGE_PREBUILTS_SPECTRUM

if BR2_PACKAGE_APPS_CAMERA
source "source/Kconfig"
endif
```
